## conf/layer.conf
```bitbake
# We have a conf and classes directory, add to BBPATH
BBPATH .= ":${LAYERDIR}"

# We have recipes-* directories, add to BBFILES
BBFILES += "${LAYERDIR}/recipes-*/*/*.bb \
            ${LAYERDIR}/recipes-*/*/*.bbappend"

BBFILE_COLLECTIONS += "meta-vk-secure"
BBFILE_PATTERN_meta-vk-secure = "^${LAYERDIR}/"

# Higher priority than meta-vk-custom (6) so bbappends overlay correctly
BBFILE_PRIORITY_meta-vk-secure = "8"

LAYERDEPENDS_meta-vk-secure = "core meta-vk-custom freescale-layer"
LAYERSERIES_COMPAT_meta-vk-secure = "scarthgap"
```

## conf/machine/ls1046a-secure.inc
```bitbake
# LS1046A Security Configuration
# Include in local.conf: require conf/machine/ls1046a-secure.inc

# Key paths (override in local.conf or CI environment)
SECURE_BOOT_KEYDIR ?= "${TOPDIR}/secure-boot-keys"
FIT_SIGN_KEYDIR ?= "${SECURE_BOOT_KEYDIR}"
FIT_SIGN_KEYNAME ?= "fit_sign_key"
OTA_SIGN_KEYDIR ?= "${SECURE_BOOT_KEYDIR}"
OTA_SIGN_KEYNAME ?= "ota_sign_key"

# U-Boot FIT signature verification
UBOOT_SIGN_ENABLE = "1"
UBOOT_SIGN_KEYDIR = "${FIT_SIGN_KEYDIR}"
UBOOT_SIGN_KEYNAME = "${FIT_SIGN_KEYNAME}"
UBOOT_SIGN_IMG_KEYNAME = "${FIT_SIGN_KEYNAME}"
UBOOT_MKIMAGE_SIGN_ARGS = "-E -p 0x1000"
FIT_SIGN_INDIVIDUAL = "1"

# dm-verity
DM_VERITY_IMAGE_TYPE = "ext4"

# Feature flag
VK_SECURE_BOOT_ENABLED = "1"
```
